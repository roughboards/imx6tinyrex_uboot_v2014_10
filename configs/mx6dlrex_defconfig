## configs/mx6dlrex_defconfig
```kconfig
CONFIG_SYS_EXTRA_OPTIONS="IMX_CONFIG=board/fedevel/mx6rex/mx6dlrex.cfg,MX6DL"
CONFIG_ARM=y
CONFIG_TARGET_MX6REX=y
```

## configs/mx6dltinyrex_defconfig
```kconfig
CONFIG_SYS_EXTRA_OPTIONS="IMX_CONFIG=board/fedevel/mx6tinyrex/mx6dltinyrex.cfg,MX6DL,DDR_SIZE=SZ_1G,MODULE_TYPE_PREFIX=\"imx6dl\",MODULE_TYPE_POSTFIX=\"\""
CONFIG_ARM=y
CONFIG_TARGET_MX6TINYREX=y
```

## configs/mx6drex_defconfig
```kconfig
CONFIG_SYS_EXTRA_OPTIONS="IMX_CONFIG=board/fedevel/mx6rex/mx6qrex.cfg,MX6D"
CONFIG_ARM=y
CONFIG_TARGET_MX6REX=y
```

## configs/mx6qrex_defconfig
```kconfig
CONFIG_SYS_EXTRA_OPTIONS="IMX_CONFIG=board/fedevel/mx6rex/mx6qrex.cfg,MX6Q"
CONFIG_ARM=y
CONFIG_TARGET_MX6REX=y
```

## configs/mx6qtinyrex_defconfig
```kconfig
CONFIG_SYS_EXTRA_OPTIONS="IMX_CONFIG=board/fedevel/mx6tinyrex/mx6qtinyrex.cfg,MX6Q"
CONFIG_ARM=y
CONFIG_TARGET_MX6TINYREX=y
```

## configs/mx6srex_defconfig
```kconfig
CONFIG_SYS_EXTRA_OPTIONS="IMX_CONFIG=board/fedevel/mx6rex/mx6srex.cfg,MX6S,DDR_SIZE=SZ_1G,ENV_IS_IN_SPI_FLASH,MODULE_TYPE_PREFIX=\"imx6s\",MODULE_TYPE_POSTFIX=\"\""
CONFIG_ARM=y
CONFIG_TARGET_MX6REX=y
```

## configs/mx6stinyrex_defconfig
```kconfig
CONFIG_SYS_EXTRA_OPTIONS="IMX_CONFIG=board/fedevel/mx6tinyrex/mx6stinyrex.cfg,MX6S,DDR_SIZE=SZ_1G,MODULE_TYPE_PREFIX=\"imx6s\",MODULE_TYPE_POSTFIX=\"\""
CONFIG_ARM=y
CONFIG_TARGET_MX6TINYREX=y
```

## configs/mx6tinyrexbasic_defconfig
```kconfig
CONFIG_SYS_EXTRA_OPTIONS="IMX_CONFIG=board/fedevel/mx6tinyrex/mx6tinyrexbasic.cfg,MX6S,DDR_512MB"
CONFIG_ARM=y
CONFIG_TARGET_MX6TINYREX=y
```

## configs/mx6tinyrexlite_defconfig
```kconfig
CONFIG_SYS_EXTRA_OPTIONS="IMX_CONFIG=board/fedevel/mx6tinyrex/mx6tinyrexlite.cfg,MX6S,DDR_SIZE=SZ_256M,MODULE_TYPE_PREFIX=\"imx6\",MODULE_TYPE_POSTFIX=\"lite\""
CONFIG_ARM=y
CONFIG_TARGET_MX6TINYREX=y
```

## configs/mx6tinyrexmax_defconfig
```kconfig
CONFIG_SYS_EXTRA_OPTIONS="IMX_CONFIG=board/fedevel/mx6tinyrex/mx6tinyrexmax.cfg,MX6Q,DDR_2GB"
CONFIG_ARM=y
CONFIG_TARGET_MX6TINYREX=y
```

## configs/mx6tinyrexpro_defconfig
```kconfig
CONFIG_SYS_EXTRA_OPTIONS="IMX_CONFIG=board/fedevel/mx6tinyrex/mx6tinyrexpro.cfg,MX6D,DDR_1GB"
CONFIG_ARM=y
CONFIG_TARGET_MX6TINYREX=y
```
